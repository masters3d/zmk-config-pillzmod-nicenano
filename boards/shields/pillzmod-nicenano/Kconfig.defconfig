## boards/shields/pillzmod-nicenano/Kconfig.defconfig
```kconfig
if SHIELD_PILLZMOD_NICENANO

config ZMK_KEYBOARD_NAME
    default "Kinesis Advantage (Pillz Mod)"

config ZMK_RGB_UNDERGLOW
    default n

config ZMK_BACKLIGHT
    default y

endif
```

## boards/shields/pillzmod-nicenano/Kconfig.shield
```kconfig
config SHIELD_PILLZMOD_NICENANO
    def_bool $(shields_list_contains,pillzmod-nicenano)
```

## boards/shields/pillzmod_pro/Kconfig.defconfig
```kconfig
# Copyright (c) 2020 The ZMK Contributors
# SPDX-License-Identifier: MIT

if SHIELD_PILLZMOD_PRO

config ZMK_KEYBOARD_NAME
    default "Pillz Mod Pro"

config SPI
    default y
    
endif
```

## boards/shields/pillzmod_pro/Kconfig.shield
```kconfig
# Copyright (c) 2020 The ZMK Contributors
# SPDX-License-Identifier: MIT

config SHIELD_PILLZMOD_PRO
    def_bool $(shields_list_contains,pillzmod_pro)
```

## boards/shields/pillzmod_pro_nicenano/Kconfig.defconfig
```kconfig
# Copyright (c) 2020 The ZMK Contributors
# SPDX-License-Identifier: MIT

if SHIELD_PILLZMOD_PRO_NICENANO

config ZMK_KEYBOARD_NAME
    default "Pillzmod Pro Nice!Nano"

config ZMK_SLEEP
    default y

endif
```

## config/west.yml
```yaml
manifest:
  remotes:
    - name: zmkfirmware
      url-base: https://github.com/zmkfirmware
  projects:
    - name: zmk
      remote: zmkfirmware
      revision: 0c8199ac54a69ba84af39bf2b984a8a5f65a2ca1
      import: app/west.yml
  self:
    path: config
```
